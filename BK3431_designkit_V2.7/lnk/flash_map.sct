#
# MODULE:         flash_map.sct
# DESCRIPTION:    ARM scatter-loading map file for chimera
# MAINTAINER:
# CREATION DATE:
#
# LICENSE:
#     This source code is copyright (C) 2000 Parthus Technologies, plc.
#     All rights reserved.
#
# SOURCE CONTROL:
#
# REVISION HISTORY:
#

ROOT 0x00000000
{
    FLASH 0x00000000
    {
        sys_boot.o (SYS_Boot, +First)
        sys_fiq_irq.o                (+RO)
        sys_irq.o                    (+RO)
        sys_mmi.o                    (+RO)
        sys_init.o                   (+RO)
        sys_power.o                  (+RO)
        sys_main.o                   (+RO)
        sys_config.o                 (+RO)
        sys_rand_num_gen.o           (+RO)
        sys_hal_config.o             (+RO)

        bksystemapi.o                (+RO)
        bkperiunitapi.o              (+RO)

        hw_delay.o                   (+RO)
        hw_lc.o                      (+RO)
        hw_radio.o                   (+RO)

        lmp_cmd_disp.o               (+RO)
        lmp_utils.o                  (+RO)

        bt_init.o                    (+RO)
        bt_timer.o                   (+RO)
        bt_mini_sched.o              (+RO)

        le_connection.o              (+RO)
        le_link_layer.o              (+RO)
        le_connection_patch.o        (+RO)
        le_link_layer_patch.o        (+RO)
        le_cts_app.o                 (+RO)
        le_scan.o                    (+RO)
        le_frequency.o               (+RO)
        #le_security.o				 (+RO)
        le_gap.o                     (+RO)
        le_advertise.o               (+RO)
        tra_hcit.o					 (+RO)
        tra_queue.o					 (+RO)
        tra_uart.o					 (+RO)
        le_gatt.o                    (+RO)
        #le_smp.o					 (+RO)
        #le_aes.o					 (+RO)
        le_gatt_server.o             (+RO)
        le_test.o                    (+RO)
        le_config.o                  (+RO)
        le_l2cap.o                   (+RO)
        le_white_list.o              (+RO)

        lc_interface.o               (+RO)
        lslc_irq.o                   (+RO)
        lslc_stat.o                  (+RO)

        #tra_hcit.o					 (+RO)
        #tra_queue.o			     (+RO)
        #tra_uart.o					 (+RO)

        tc_interface.o               (+RO)
        tc_cmd_disp.o                (+RO)
        tc_event_gen.o               (+RO)

        hc_flow_control.o            (+RO)
        hc_cmd_disp.o                (+RO)
        hc_event_gen.o               (+RO)
        hcit_chimera_16550_serial.o  (+RO)

        *(+RO)
    }
    SRAM 0x00400000 NOCOMPRESS
    {
        *(+RW,+ZI)
    }
}
